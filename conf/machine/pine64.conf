## conf/machine/pine64.conf
```bitbake
#@TYPE: Machine
#@NAME: pine64

#@DESCRIPTION: Machine configuration for pine64 systems

require conf/machine/include/arm/arch-arm64.inc

#
# Which X video driver do we use for upstream?
#
PREFERRED_PROVIDER_virtual/xserver = "xserver-xorg"
XSERVER = "xserver-xorg \
           xf86-video-fbturbo \
           xf86-input-evdev \
           xf86-input-mouse \
           xf86-input-keyboard"

MACHINE_ESSENTIAL_EXTRA_RRECOMMENDS = " kernel-modules"
# kernel-base contains the module deps files, and depends on kernel, which
# sucks in the kernel image, which just plain sucks if you only want the
# modules in your filesystem image.
# BAD_RECOMMENDATIONS = "kernel kernel-image kernel-image-image virtual/kernel"

PREFERRED_PROVIDER_virtual/bootloader = "u-boot"
PREFERRED_VERSION_u-boot = "2017.11"

PREFERRED_PROVIDER_virtual/arm-trusted-firmware ?= "arm-trusted-firmware-pine64-apritzel"
# PREFERRED_PROVIDER_virtual/kernel ?= "linux-sunxi-pine64"
PREFERRED_PROVIDER_virtual/kernel ?= "linux-yocto-custom"

UBOOT_MACHINE ?= "pine64_plus_config"
KERNEL_DEVICETREE ?= "allwinner/sun50i-a64-pine64.dtb allwinner/sun50i-a64-pine64-plus.dtb"
IMAGE_BOOT_FILES ?= " \
    Image-sun50i-a64-pine64.dtb;allwinner/sun50i-a64-pine64.dtb \
    Image-sun50i-a64-pine64-plus.dtb;allwinner/sun50i-a64-pine64-plus.dtb \
    Image-pine64.bin;Image \
    pine64-boot.scr.uimg;boot.scr.uimg \
    "
WKS_FILE ?= "pine64-image.wks"

KERNEL_IMAGETYPE ?= "Image"

IMAGE_FSTYPES ?= "tar.bz2 wic"
do_image_wic[depends] += "mtools-native:do_populate_sysroot dosfstools-native:do_populate_sysroot"
do_image_wic[depends] += "virtual/bootloader:do_deploy u-boot-script:do_deploy"

SERIAL_CONSOLE ?= "115200 ttyS0"
MACHINE_FEATURES ?= "alsa apm keyboard rtc serial screen usbgadget usbhost vfat"
```

## scripts/lib/wic/canned-wks/pine64-image.wks
```
# short-description: Create Pine64 SD card image
# long-description: Creates a partitioned SD card image. Boot files
# are located in the first vfat partition and raw bootloaders are
# placed in the raw SD.

part loaders --source rawcopy --sourceparams="file=boot-firmware.bin" --ondisk mmcblk --no-table --align 8
part /boot --source bootimg-partition --ondisk mmcblk --fstype=vfat --label pine64 --active --align 32
part / --source rootfs --ondisk mmcblk --fstype=ext3 --label platform --align 32
```
